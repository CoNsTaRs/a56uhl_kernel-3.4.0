qcom,A56-id2-batterydata {
	qcom,fcc-mah = <2700>;
	qcom,default-rbatt-mohm = <250>;
	qcom,rbatt-capacitive-mohm = <0>;
	qcom,max-voltage-uv = <4400000>;
	qcom,v-cutoff-uv = <3000000>;
	qcom,chg-term-ua = <40000>;
	qcom,batt-id-kohm = <33>;
	qcom,warm-bat-ma = <1800>;
	qcom,cool-bat-ma = <1300>;
	htc,capacity = <2700>;
	htc,batt_id = <2>;
	htc,id_raw_min = <301>;
	htc,id_raw_max = <600>;
	htc,type = <1>;
	htc,model_name = "B0P6B100";

	qcom,fcc-temp-lut {
		qcom,lut-col-legend = <(-20) (-10) 0 10 20 25 30 40 60>;
		qcom,lut-data = <2600 2650 2700 2700 2710 2710 2710 2740 2740>;
	};

	qcom,pc-temp-ocv-lut {
		qcom,lut-col-legend = <(-20) (-10) 0 10 20 25 30 40 60>;
		qcom,lut-row-legend = <100 95 90 85 80 75 70 65 60 55 50 45 40 35 30 25 20 16 13 11 10 9 8 7 6 5 4 3 2 1 0>;
		qcom,lut-data = <4380 4380 4380 4380 4380 4380 4380 4380 4380>,
				<4288 4312 4319 4322 4322 4322 4321 4320 4315>,
				<4213 4248 4258 4260 4261 4261 4261 4260 4256>,
				<4148 4186 4199 4202 4202 4202 4202 4202 4196>,
				<4092 4126 4142 4144 4145 4145 4146 4144 4140>,
				<4038 4070 4086 4090 4090 4090 4090 4090 4086>,
				<3946 4006 4027 4040 4040 4040 4040 4040 4036>,
				<3906 3940 3956 3976 3987 3989 3990 3991 3990>,
				<3866 3905 3917 3926 3940 3944 3946 3948 3946>,
				<3828 3870 3882 3886 3890 3892 3894 3898 3896>,
				<3808 3838 3850 3853 3855 3855 3856 3858 3856>,
				<3792 3810 3823 3827 3828 3830 3830 3831 3830>,
				<3777 3790 3801 3806 3808 3808 3809 3810 3809>,
				<3764 3775 3784 3788 3790 3791 3791 3792 3791>,
				<3750 3760 3771 3774 3776 3776 3776 3775 3772>,
				<3736 3744 3759 3764 3763 3761 3760 3754 3742>,
				<3720 3730 3743 3747 3745 3742 3740 3734 3721>,
				<3706 3719 3724 3727 3724 3722 3720 3714 3700>,
				<3690 3710 3707 3706 3703 3701 3699 3694 3680>,
				<3676 3702 3700 3696 3693 3692 3689 3684 3673>,
				<3667 3698 3696 3694 3692 3690 3688 3683 3672>,
				<3657 3692 3694 3692 3690 3688 3686 3682 3671>,
				<3646 3686 3690 3690 3688 3687 3686 3681 3670>,
				<3632 3678 3688 3688 3686 3686 3683 3678 3667>,
				<3614 3665 3681 3683 3682 3680 3678 3672 3658>,
				<3588 3643 3664 3666 3662 3660 3658 3652 3630>,
				<3558 3609 3624 3625 3620 3618 3616 3608 3584>,
				<3513 3558 3568 3566 3561 3560 3558 3551 3524>,
				<3446 3485 3490 3488 3482 3480 3480 3473 3444>,
				<3331 3368 3372 3370 3363 3361 3360 3352 3318>,
				<3000 3000 3000 3000 3000 3000 3000 3000 3000>;
	};

	qcom,rbatt-sf-lut {
		qcom,lut-col-legend = <(-20) (-10) 0 10 20 25 30 40 60>;
		qcom,lut-row-legend = <100 95 90 85 80  75 70 65 60 55 50 45 40 35 30 25 20 16 13 11 10 9 8 7 6 5 4 3 2 1>;
		qcom,lut-data = <360 180 150 135 101 93 93 86 80>,
				<360 180 150 135 101 93 93 86 80>,
				<360 180 150 135 101 95 95 87 80>,
				<360 180 150 135 103 97 97 89 82>,
				<360 180 150 135 107 99 99 90 83>,
				<360 180 150 135 111 102 102 93 84>,
				<360 180 150 135 118 107 107 96 86>,
				<360 180 150 135 125 115 115 101 89>,
				<360 180 150 135 126 119 119 106 92>,
				<360 180 150 135 106 103 103 97 89>,
				<360 180 150 135 99 93 93 86 81>,
				<360 180 150 135 99 93 93 86 82>,
				<360 180 150 135 101 95 95 89 83>,
				<360 180 150 135 103 97 97 92 86>,
				<360 180 150 135 103 97 97 92 86>,
				<360 180 150 135 102 95 95 86 80>,
				<360 180 150 135 101 94 94 86 80>,
				<360 180 150 135 102 96 96 88 81>,
				<360 180 150 135 102 95 95 86 80>,
				<360 180 150 135 100 93 93 85 80>,
				<360 180 150 135 101 95 95 86 82>,
				<360 180 150 135 103 96 96 89 83>,
				<360 180 150 135 105 98 98 91 86>,
				<360 180 150 135 105 98 98 91 86>,
				<360 180 150 135 105 98 98 91 86>,
				<360 180 150 135 105 98 98 91 86>,
				<360 180 150 135 105 98 98 91 86>,
				<360 180 150 135 105 98 98 91 86>,
				<360 180 150 135 105 98 98 91 86>,
				<360 180 150 135 105 98 98 91 86>;
	};
};
