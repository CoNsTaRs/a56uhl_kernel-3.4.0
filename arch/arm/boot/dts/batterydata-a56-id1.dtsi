qcom,A56-id1-batterydata {
	qcom,fcc-mah = <2700>;
	qcom,default-rbatt-mohm = <250>;
	qcom,rbatt-capacitive-mohm = <0>;
	qcom,flat-ocv-threshold-uv = <3800000>;
	qcom,max-voltage-uv = <4400000>;
	qcom,v-cutoff-uv = <3000000>;
	qcom,chg-term-ua = <40000>;
	qcom,batt-id-kohm = <10>;
	qcom,warm-bat-ma = <1800>;
	qcom,cool-bat-ma = <1300>;
	htc,capacity = <2700>;
	htc,batt_id = <1>;
	htc,id_raw_min = <0>;
	htc,id_raw_max = <300>;
	htc,type = <1>;
	htc,model_name = "B0P6B100";

	qcom,fcc-temp-lut {
		qcom,lut-col-legend = <(-20) (-10) 0 10 20 25 30 40 60>;
		qcom,lut-data = <2600 2650 2700 2700 2720 2720 2720 2750 2750>;
	};

	qcom,pc-temp-ocv-lut {
		qcom,lut-col-legend = <(-20) (-10) 0 10 20 25 30 40 60>;
		qcom,lut-row-legend = <100 95 90 85 80>,
					<75 70 65 60 55>,
					<50 45 40 35 30>,
					<25 20 16 13 11>,
					<10 9 8 7 6>,
					<5 4 3 2 1>,
					<0>;
		qcom,lut-data = <4380 4380 4380 4380 4380 4380 4380 4380 4380>,
				<4254 4290 4301 4306 4308 4309 4308 4308 4304>,
				<4178 4224 4240 4246 4248 4250 4249 4248 4244>,
				<4117 4164 4182 4188 4190 4192 4191 4190 4188>,
				<4062 4104 4126 4134 4135 4136 4136 4135 4132>,
				<3972 4052 4074 4082 4082 4082 4082 4082 4079>,
				<3924 3976 4016 4030 4033 4033 4033 4032 4030>,
				<3878 3927 3949 3972 3982 3984 3985 3986 3985>,
				<3842 3891 3910 3926 3940 3943 3944 3946 3944>,
				<3822 3854 3874 3882 3890 3894 3898 3900 3901>,
				<3804 3822 3842 3848 3851 3852 3853 3854 3855>,
				<3790 3802 3815 3822 3825 3826 3827 3828 3828>,
				<3774 3786 3794 3801 3804 3805 3806 3807 3807>,
				<3760 3772 3781 3784 3787 3788 3788 3790 3789>,
				<3744 3756 3770 3774 3774 3775 3774 3774 3770>,
				<3729 3740 3757 3764 3764 3762 3760 3756 3744>,
				<3713 3726 3740 3746 3746 3744 3742 3736 3722>,
				<3696 3714 3716 3724 3722 3720 3718 3712 3699>,
				<3684 3704 3702 3700 3697 3695 3693 3688 3676>,
				<3671 3694 3693 3692 3690 3688 3687 3683 3671>,
				<3662 3691 3690 3690 3689 3688 3686 3682 3670>,
				<3654 3685 3687 3688 3687 3686 3685 3681 3669>,
				<3644 3680 3684 3686 3686 3685 3684 3680 3668>,
				<3630 3672 3682 3684 3684 3683 3682 3677 3665>,
				<3612 3660 3674 3678 3678 3680 3677 3672 3654>,
				<3589 3638 3658 3662 3658 3656 3656 3645 3625>,
				<3556 3603 3619 3618 3614 3610 3609 3598 3576>,
				<3506 3550 3559 3557 3550 3548 3544 3538 3514>,
				<3426 3469 3476 3472 3466 3462 3458 3456 3428>,
				<3294 3336 3344 3340 3331 3328 3322 3324 3292>,
				<3000 3000 3000 3000 3000 3000 3000 3000 3000>;
	};

	qcom,rbatt-sf-lut {
		qcom,lut-col-legend = <(-20) (-10) 0 10 20 25 30 40 60>;
		qcom,lut-row-legend = <100 95 90 85 80>,
					<75 70 65 60 55>,
					<50 45 40 35 30>,
					<25 20 16 13 11>,
					<10 9 8 7 6>,
					<5 4 3 2 1>;
		qcom,lut-data = <360 180 150 135 100 90 90 79 72>,
				<360 180 150 135 100 90 90 79 72>,
				<360 180 150 135 100 90 90 80 72>,
				<360 180 150 135 101 91 91 81 73>,
				<360 180 150 135 103 93 93 83 74>,
				<360 180 150 135 107 97 97 85 75>,
				<360 180 150 135 112 100 100 88 78>,
				<360 180 150 135 116 104 104 91 80>,
				<360 180 150 135 120 109 109 96 83>,
				<360 180 150 135 109 103 103 93 83>,
				<360 180 150 135 96 88 88 79 73>,
				<360 180 150 135 96 87 87 79 72>,
				<360 180 150 135 97 90 90 81 74>,
				<360 180 150 135 98 91 91 84 76>,
				<360 180 150 135 101 92 92 83 76>,
				<360 180 150 135 102 92 92 80 72>,
				<360 180 150 135 101 92 92 80 72>,
				<360 180 150 135 101 92 92 80 72>,
				<360 180 150 135 98 89 89 80 71>,
				<360 180 150 135 98 89 89 80 71>,
				<360 180 150 135 100 90 90 81 72>,
				<360 180 150 135 102 93 93 83 74>,
				<360 180 150 135 104 96 96 84 75>,
				<360 180 150 135 104 96 96 84 75>,
				<360 180 150 135 104 96 96 84 75>,
				<360 180 150 135 104 96 96 84 75>,
				<360 180 150 135 104 96 96 84 75>,
				<360 180 150 135 104 96 96 84 75>,
				<360 180 150 135 104 96 96 84 75>,
				<360 180 150 135 104 96 96 84 75>;
	};
};
